#include "FastLED.h"
#define NUM_LEDS 58
#define DATA_PIN 6

unsigned  char i;
unsigned char m;
unsigned int wait = 1;
unsigned int wait2 =10;
byte  hall = 0;
CRGB leds[NUM_LEDS];
bool kalp[40][75] = {

{0,  0,  0,  0,  0,  0,  0,  0,  0,  0,  0,  0,  0,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  0,  0},
{0, 0,  0,  0,  0,  0,  0,  0,  0,  0,  0,  0,  0,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  0,  0},
{0, 0,  0,  1,  1,  1,  0,  0,  0,  0,  0,  1,  1,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  0,  0},
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{0, 0,  0,  0,  0,  0,  0,  0,  0,  0,  0,  0,  0,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  0,  0}
};


void setup() {
 
  FastLED.addLeds<WS2812B, DATA_PIN, RGB>(leds, NUM_LEDS);
 /*EICRA = 0;
  EICRA |= (1 << ISC10);
  EIMSK = 0;
  EIMSK |= (1 << INT1);
  sei();*/

  attachInterrupt(1, LEDiyak, RISING);
  for (int i = 0; i < 58; i++) {
   leds[i]  = CRGB ::Black;
  }
  FastLED.show();
  //Serial.begin(9600);
}


void  LEDiyak()
{
 hall++;
  //Serial.println("kesme");
  if(hall>2)
  {hall=0;}
}

void loop() {
  if (hall >0) {
    
   // delay(10);
    for (m = 0; m < 75; m++) {
      for (i = 0; i < 40; i++) {
        if  (kalp[i][m] == 1) {
          leds[i + 7] = CRGB::Green;
        }
        else  {
          leds[i + 7] = CRGB::Blue;
        }
      }
      FastLED.show();
      delayMicroseconds(wait);
    }

    for (int i = 0; i < 58; i++)  {
      leds[i] = CRGB ::Blue;
    }
    FastLED.show();
    delayMicroseconds(wait2);

   
  
    for (int i = 0; i < 58; i++) {
      leds[i] = CRGB ::White;
    }
    FastLED.show();
    delayMicroseconds(wait2);
    //hall=0;
  }
}

